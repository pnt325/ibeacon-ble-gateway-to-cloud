## firmware-blegateway/main/Kconfig.projbuild
```kconfig
menu "BLE Gateway Configuration"
    config ESP_WIFI_AP_SSID
        string "WiFi AP SSID"
        default "BGATEWAY"
        help
            SSID (network name) for the example to connect to.

    config ESP_WIFI_AP_PASSWORD
        string "WiFi AP Password"
        default "password2342"
        help
            WiFi password (WPA or WPA2) for the example to use.
    config ESP_WIFI_AP_CHANNEL
        int "WiFi Channel"
        range 1 13
        default 1
        help
            WiFi channel (network channel) for the example to use.

    config ESP_MAX_AP_STA_CONN
        int "Maximal STA connections"
        default 4
        help
            Max number of the STA connects to AP.

    config ESP_MAXIMUM_RETRY
        int "Maximum retry"
        default 5
        help
            Set the Maximum retry to avoid station reconnecting to the AP unlimited when the AP is really inexistent.
    config BLE_GATEWAY_ADV_NAME
        string "Bluetooth advertising name"
        default "BLE Gateway"
        help
            Set the bluetooth advertising name show on smart phone for WIFI configurations
endmenu
```
